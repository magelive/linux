## module/Kconfig
```kconfig
# SPDX-License-Identifier: GPL-2.0-only
#
# kernel test modules configuration
#

menu "kernel test modules"

source "module/hello/Kconfig"

endmenu
```

## module/hello/Kconfig
```kconfig
# SPDX-License-Identifier: GPL-2.0-only
#
# kernel test modules configuration
#

config MODULES_HELLO
	bool "test module hello."
	default y
	help
		This the first test module, called the hello kernel word.
```
